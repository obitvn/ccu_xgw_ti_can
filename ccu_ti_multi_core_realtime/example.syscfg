/**
 * @cliArgs --device "AM263Px" --part "AM263P4" --package "ZCZ_C" --context "r5fss1-1" --product "MCU_PLUS_SDK_AM263Px@11.01.00"
 * @versions {"tool":"1.26.0+4407"}
 */

/**
 * Import the modules used in this configuration.
 */
const gpio            = scripting.addModule("/drivers/gpio/gpio", {}, false);
const gpio1           = gpio.addInstance();
const gpio2           = gpio.addInstance();
const gpio3           = gpio.addInstance();
const gpio4           = gpio.addInstance();
const gpio5           = gpio.addInstance();
const gpio6           = gpio.addInstance();
const gpio7           = gpio.addInstance();
const gpio8           = gpio.addInstance();
const ipc             = scripting.addModule("/drivers/ipc/ipc");
const mcan            = scripting.addModule("/drivers/mcan/mcan", {}, false);
const mcan1           = mcan.addInstance();
const mcan2           = mcan.addInstance();
const mcan3           = mcan.addInstance();
const mcan4           = mcan.addInstance();
const mcan5           = mcan.addInstance();
const mcan6           = mcan.addInstance();
const mcan7           = mcan.addInstance();
const mcan8           = mcan.addInstance();
const uart            = scripting.addModule("/drivers/uart/uart", {}, false);
const uart1           = uart.addInstance();
const debug_log       = scripting.addModule("/kernel/dpl/debug_log");
const dpl_cfg         = scripting.addModule("/kernel/dpl/dpl_cfg");
const mpu_armv7       = scripting.addModule("/kernel/dpl/mpu_armv7", {}, false);
const mpu_armv71      = mpu_armv7.addInstance();
const mpu_armv72      = mpu_armv7.addInstance();
const mpu_armv73      = mpu_armv7.addInstance();
const mpu_armv74      = mpu_armv7.addInstance();
const mpu_armv75      = mpu_armv7.addInstance();
const mpu_armv76      = mpu_armv7.addInstance();
const mpu_armv77      = mpu_armv7.addInstance();
const timer           = scripting.addModule("/kernel/dpl/timer", {}, false);
const timer1          = timer.addInstance();
const default_linker  = scripting.addModule("/memory_configurator/default_linker", {}, false);
const default_linker1 = default_linker.addInstance();
const general         = scripting.addModule("/memory_configurator/general", {}, false);
const general1        = general.addInstance();
const region          = scripting.addModule("/memory_configurator/region", {}, false);
const region1         = region.addInstance();
const section         = scripting.addModule("/memory_configurator/section", {}, false);
const section1        = section.addInstance();
const section2        = section.addInstance();
const section3        = section.addInstance();
const section4        = section.addInstance();
const section5        = section.addInstance();
const section6        = section.addInstance();
const section7        = section.addInstance();
const section8        = section.addInstance();
const section9        = section.addInstance();
const section10       = section.addInstance();
const section11       = section.addInstance();
const section12       = section.addInstance();

/**
 * Write custom configuration values to the imported modules.
 */
gpio1.pinDir         = "OUTPUT";
gpio1.$name          = "CONFIG_GPIO_STB_MCAN4";
gpio1.GPIO_n.$assign = "EPWM0_A";

gpio2.pinDir         = "OUTPUT";
gpio2.$name          = "CONFIG_GPIO_STB_MCAN3";
gpio2.GPIO_n.$assign = "EPWM1_A";

gpio3.pinDir         = "OUTPUT";
gpio3.$name          = "CONFIG_GPIO_STB_MCAN5";
gpio3.GPIO_n.$assign = "EPWM9_B";

gpio4.pinDir         = "OUTPUT";
gpio4.$name          = "CONFIG_GPIO_STB_MCAN7";
gpio4.GPIO_n.$assign = "EPWM13_B";

gpio5.pinDir         = "OUTPUT";
gpio5.$name          = "CONFIG_GPIO_STB_MCAN2";
gpio5.GPIO_n.$assign = "EQEP0_A";

gpio6.pinDir         = "OUTPUT";
gpio6.$name          = "CONFIG_GPIO_STB_MCAN1";
gpio6.GPIO_n.$assign = "MMC_SDWP";

gpio7.pinDir         = "OUTPUT";
gpio7.$name          = "CONFIG_GPIO_STB_MCAN6";
gpio7.GPIO_n.$assign = "EPWM0_B";

gpio8.pinDir         = "OUTPUT";
gpio8.$name          = "CONFIG_GPIO_STB_MCAN0";
gpio8.GPIO_n.$assign = "MMC_SDCD";

ipc.r5fss0_0 = "notify";
ipc.r5fss0_1 = "NONE";
ipc.r5fss1_0 = "NONE";

mcan1.$name           = "CONFIG_MCAN3";
mcan1.MCAN.$assign    = "MCAN3";
mcan1.MCAN.RX.$assign = "UART0_CTSn";
mcan1.MCAN.TX.$assign = "UART0_RTSn";

mcan2.$name           = "CONFIG_MCAN2";
mcan2.MCAN.$assign    = "MCAN2";
mcan2.MCAN.RX.$assign = "MCAN2_RX";
mcan2.MCAN.TX.$assign = "MCAN2_TX";

mcan3.$name           = "CONFIG_MCAN7";
mcan3.MCAN.$assign    = "MCAN7";
mcan3.MCAN.RX.$assign = "EPWM12_A";
mcan3.MCAN.TX.$assign = "EPWM12_B";

mcan4.$name           = "CONFIG_MCAN6";
mcan4.MCAN.$assign    = "MCAN6";
mcan4.MCAN.RX.$assign = "EPWM14_A";
mcan4.MCAN.TX.$assign = "EPWM14_B";

mcan5.$name           = "CONFIG_MCAN0";
mcan5.MCAN.$assign    = "MCAN0";
mcan5.MCAN.RX.$assign = "MMC_CLK";
mcan5.MCAN.TX.$assign = "MMC_CMD";

mcan6.$name           = "CONFIG_MCAN1";
mcan6.MCAN.$assign    = "MCAN1";
mcan6.MCAN.RX.$assign = "MMC_DAT0";
mcan6.MCAN.TX.$assign = "MMC_DAT1";

mcan7.$name           = "CONFIG_MCAN4";
mcan7.MCAN.$assign    = "MCAN4";
mcan7.MCAN.RX.$assign = "MMC_DAT2";
mcan7.MCAN.TX.$assign = "MMC_DAT3";

mcan8.$name           = "CONFIG_MCAN5";
mcan8.MCAN.$assign    = "MCAN5";
mcan8.MCAN.RX.$assign = "EPWM10_A";
mcan8.MCAN.TX.$assign = "EPWM10_B";

const mcan_v1_template  = scripting.addModule("/drivers/mcan/v1/mcan_v1_template", {}, false);
const mcan_v1_template1 = mcan_v1_template.addInstance({}, false);
mcan_v1_template1.$name = "drivers_mcan_v1_mcan_v1_template0";
mcan1.child             = mcan_v1_template1;
mcan2.child             = mcan_v1_template1;
mcan3.child             = mcan_v1_template1;
mcan4.child             = mcan_v1_template1;
mcan5.child             = mcan_v1_template1;
mcan6.child             = mcan_v1_template1;
mcan7.child             = mcan_v1_template1;
mcan8.child             = mcan_v1_template1;

uart1.$name                     = "CONFIG_UART5";
uart1.operMode                  = "13X";
uart1.rxTrigLvl                 = "8";  /* Trigger on 8 bytes (fits ~1 YIS320 frame) */
uart1.txTrigLvl                 = "4";
uart1.intrPriority              = 8;  /* Lower priority (higher number) to avoid preempting CAN TX task */
uart1.baudRate                  = 921600;
uart1.intrEnable                = "USER_INTR";  /* User manages interrupt - driver will set skipIntrReg=TRUE */
uart1.UART.$assign              = "UART5";
uart1.UART.RXD.$assign          = "SDFM0_CLK3";
uart1.UART.TXD.$assign          = "SDFM0_CLK2";
uart1.child.$name               = "drivers_uart_v2_uart_v2_template1";  /* Changed to match reference ccu_ti */

debug_log.enableCssLog       = false;
debug_log.enableSharedMemLog = true;

mpu_armv71.$name             = "CONFIG_MPU_REGION0";
mpu_armv71.size              = 31;
mpu_armv71.attributes        = "Device";
mpu_armv71.accessPermissions = "Supervisor RD+WR, User RD";
mpu_armv71.allowExecute      = false;

mpu_armv72.$name             = "CONFIG_MPU_REGION1";
mpu_armv72.size              = 15;
mpu_armv72.accessPermissions = "Supervisor RD+WR, User RD";

mpu_armv73.$name             = "CONFIG_MPU_REGION2";
mpu_armv73.baseAddr          = 0x80000;
mpu_armv73.size              = 15;
mpu_armv73.accessPermissions = "Supervisor RD+WR, User RD";

mpu_armv74.$name             = "CONFIG_MPU_REGION3";
mpu_armv74.accessPermissions = "Supervisor RD+WR, User RD";
mpu_armv74.baseAddr          = 0x70000000;
mpu_armv74.size              = 21;

mpu_armv75.$name        = "CONFIG_MPU_REGION4";
mpu_armv75.size         = 14;
mpu_armv75.baseAddr     = 0x50D00000;
mpu_armv75.allowExecute = false;
mpu_armv75.attributes   = "Device";

mpu_armv76.$name        = "CONFIG_MPU_REGION5";
mpu_armv76.size         = 14;
mpu_armv76.allowExecute = false;
mpu_armv76.attributes   = "NonCached";
mpu_armv76.baseAddr     = 0x72000000;

mpu_armv77.$name        = "CONFIG_MPU_REGION6";
mpu_armv77.size         = 16;
mpu_armv77.allowExecute = false;
mpu_armv77.baseAddr     = 0x701D0000;
mpu_armv77.attributes   = "NonCached";

timer1.$name         = "CONFIG_TIMER0";
timer1.timerCallback = "timerISR";
timer1.RTI.$assign   = "RTI2";

default_linker1.$name = "memory_configurator_default_linker0";

general1.$name        = "CONFIG_GENERAL0";
general1.linker.$name = "TIARMCLANG0";

region1.$name                               = "MEMORY_REGION_CONFIGURATION0";
region1.memory_region.create(5);
region1.memory_region[0].type               = "TCMA";
region1.memory_region[0].$name              = "R5F_VECS";
region1.memory_region[0].auto               = false;
region1.memory_region[0].size               = 0x40;
region1.memory_region[1].type               = "TCMA";
region1.memory_region[1].$name              = "R5F_TCMA";
region1.memory_region[1].size               = 0x7FC0;
region1.memory_region[2].type               = "TCMB";
region1.memory_region[2].size               = 0x8000;
region1.memory_region[2].$name              = "R5F_TCMB";
region1.memory_region[3].$name              = "OCRAM";
region1.memory_region[3].auto               = false;
region1.memory_region[3].manualStartAddress = 0x70180000;
region1.memory_region[3].size               = 0x80000;
region1.memory_region[4].type               = "FLASH";
region1.memory_region[4].auto               = false;
region1.memory_region[4].manualStartAddress = 0x60180000;
region1.memory_region[4].size               = 0x80000;
region1.memory_region[4].$name              = "FLASH";

section1.load_memory                  = "R5F_VECS";
section1.group                        = false;
section1.$name                        = "Vector Table";
section1.output_section.create(1);
section1.output_section[0].$name      = ".vectors";
section1.output_section[0].palignment = true;

section2.load_memory                  = "OCRAM";
section2.$name                        = "Text Segments";
section2.output_section.create(5);
section2.output_section[0].$name      = ".text.hwi";
section2.output_section[0].palignment = true;
section2.output_section[1].$name      = ".text.cache";
section2.output_section[1].palignment = true;
section2.output_section[2].$name      = ".text.mpu";
section2.output_section[2].palignment = true;
section2.output_section[3].$name      = ".text.boot";
section2.output_section[3].palignment = true;
section2.output_section[4].$name      = ".text:abort";
section2.output_section[4].palignment = true;

section3.load_memory                  = "OCRAM";
section3.$name                        = "Code and Read-Only Data";
section3.output_section.create(2);
section3.output_section[0].$name      = ".text";
section3.output_section[0].palignment = true;
section3.output_section[1].$name      = ".rodata";
section3.output_section[1].palignment = true;

section4.load_memory                  = "OCRAM";
section4.$name                        = "Data Segment";
section4.output_section.create(1);
section4.output_section[0].$name      = ".data";
section4.output_section[0].palignment = true;

section5.load_memory                             = "OCRAM";
section5.$name                                   = "Memory Segments";
section5.output_section.create(3);
section5.output_section[0].$name                 = ".bss";
section5.output_section[0].output_sections_start = "__BSS_START";
section5.output_section[0].output_sections_end   = "__BSS_END";
section5.output_section[0].palignment            = true;
section5.output_section[1].$name                 = ".sysmem";
section5.output_section[1].palignment            = true;
section5.output_section[2].$name                 = ".stack";
section5.output_section[2].palignment            = true;

section6.load_memory                              = "OCRAM";
section6.$name                                    = "Stack Segments";
section6.output_section.create(5);
section6.output_section[0].$name                  = ".irqstack";
section6.output_section[0].output_sections_start  = "__IRQ_STACK_START";
section6.output_section[0].output_sections_end    = "__IRQ_STACK_END";
section6.output_section[0].input_section.create(1);
section6.output_section[0].input_section[0].$name = ". = . + __IRQ_STACK_SIZE;";
section6.output_section[1].$name                  = ".fiqstack";
section6.output_section[1].output_sections_start  = "__FIQ_STACK_START";
section6.output_section[1].output_sections_end    = "__FIQ_STACK_END";
section6.output_section[1].input_section.create(1);
section6.output_section[1].input_section[0].$name = ". = . + __FIQ_STACK_SIZE;";
section6.output_section[2].$name                  = ".svcstack";
section6.output_section[2].output_sections_start  = "__SVC_STACK_START";
section6.output_section[2].output_sections_end    = "__SVC_STACK_END";
section6.output_section[2].input_section.create(1);
section6.output_section[2].input_section[0].$name = ". = . + __SVC_STACK_SIZE;";
section6.output_section[3].$name                  = ".abortstack";
section6.output_section[3].output_sections_start  = "__ABORT_STACK_START";
section6.output_section[3].output_sections_end    = "__ABORT_STACK_END";
section6.output_section[3].input_section.create(1);
section6.output_section[3].input_section[0].$name = ". = . + __ABORT_STACK_SIZE;";
section6.output_section[4].$name                  = ".undefinedstack";
section6.output_section[4].output_sections_start  = "__UNDEFINED_STACK_START";
section6.output_section[4].output_sections_end    = "__UNDEFINED_STACK_END";
section6.output_section[4].input_section.create(1);
section6.output_section[4].input_section[0].$name = ". = . + __UNDEFINED_STACK_SIZE;";

section7.load_memory                  = "OCRAM";
section7.$name                        = "Initialization and Exception Handling";
section7.output_section.create(3);
section7.output_section[0].$name      = ".ARM.exidx";
section7.output_section[0].palignment = true;
section7.output_section[1].$name      = ".init_array";
section7.output_section[1].palignment = true;
section7.output_section[2].$name      = ".fini_array";
section7.output_section[2].palignment = true;

section8.load_memory                 = "USER_SHM_MEM";
section8.type                        = "NOLOAD";
section8.$name                       = "User Shared Memory";
section8.group                       = false;
section8.output_section.create(2);
section8.output_section[0].$name     = ".bss.user_shared_mem";
section8.output_section[0].alignment = 0;
section8.output_section[1].$name     = ".bss.user_shared_mem_debug";
section8.output_section[1].alignment = 0;

section9.load_memory                 = "LOG_SHM_MEM";
section9.$name                       = "Log Shared Memory";
section9.group                       = false;
section9.type                        = "NOLOAD";
section9.output_section.create(1);
section9.output_section[0].$name     = ".bss.log_shared_mem";
section9.output_section[0].alignment = 0;

section10.load_memory                 = "RTOS_NORTOS_IPC_SHM_MEM";
section10.type                        = "NOLOAD";
section10.$name                       = "IPC Shared Memory";
section10.group                       = false;
section10.output_section.create(1);
section10.output_section[0].$name     = ".bss.ipc_vring_mem";
section10.output_section[0].alignment = 0;

section11.load_memory                 = "MAILBOX_HSM";
section11.type                        = "NOLOAD";
section11.$name                       = "SIPC HSM Queue Memory";
section11.group                       = false;
section11.output_section.create(1);
section11.output_section[0].$name     = ".bss.sipc_hsm_queue_mem";
section11.output_section[0].alignment = 0;

section12.load_memory                 = "MAILBOX_R5F";
section12.$name                       = "SIPC R5F Queue Memory";
section12.group                       = false;
section12.type                        = "NOLOAD";
section12.output_section.create(1);
section12.output_section[0].$name     = ".bss.sipc_secure_host_queue_mem";
section12.output_section[0].alignment = 0;
